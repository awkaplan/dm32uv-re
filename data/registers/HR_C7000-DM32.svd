# HR_C7000_DM32 register map
Vendor: Dahua Technology (chip); Baofeng (radio product); Series: HR_C7000; File version: 0.1-dm32re-draft
Reverse-engineering-derived CMSIS-SVD for the HR_C7000 SoC as used in the Baofeng DM-32UV. NOT an official Dahua/Baofeng artifact: assembled from the HR_C7000 v2.7 chip user guide (and the v2.2 manual) plus evidence from the stock DM32.00.01.048 firmware and a running radio. CK803S (C-SKY V2) core, up to 192 MHz, 320 KB SRAM. Confidence varies per register; see each description.
CPU: other r0p0, little endian, no MPU, no FPU, 0 interrupt priority bits
Registers are 32-bit, read-write, reset 0x0 unless marked. A register's access mark holds for its fields unless they carry their own. Offsets are from the block's base; lines under a group give offsets from that group; [hi:lo] are bit positions; {n}, {i} and the like mark numbered series; 'fields as' and 'values as' point back to an identical list; <NAME> marks a mode.

## Memory map
0x11000000 SystemControl size 0x10000 — Baseband/modem system control and clock manager, 64 KB window at 0x11000000 (memory map, v2.2 manual p.10). Registers from several datasheet chapters share this window: soft reset (DS §4.1), clock manager (§4.2), system control and pad mux (§4.4), baseband system control (§4.6, Register Table 4 p.144-146), DMR physical layer (§9.2, Register Table 27 p.490-492), DMR link layer (§10.2, Register Table 28 p.526-527) and FM (§11.2). HAND-MAINTAINED and not yet complete: the datasheet also lists IOMGR_REN_REG1 (0x44), IOMGR_IE_IE0-2 (0x4c-0x54), RTC_REQ_HOLD (0x58), RECV_INFO_COUNT (0x164), RECVFIR_COEF1-17 (0x16c-0x1ac), PHY_RECEIVE_STATE (0x1c0), LAYER2_MAX_CNT (0x410), LAYER2_BS_MODE (0x428), BS_SECOND_REG (0x430), BS_STATUS (0x434), BS_CACH (0x438), FM_SQL (0x508), USER_DEFINE_CTC (0x51c), CDCSS_ADDR (0x520), XTCSS_ADDR (0x52c), FM_FUNCTION_COEF1-8 (0x530-0x54c), FM_DECODE_FLAG1 (0x564) and FM_ADDR_SW (0x56c), which are not described here (their offsets fall inside the RESERVED gaps). Three registers (REG_0x168, REG_0x370-REG_0x37c, INTERP_CLEAR_AUX) are not in the datasheet and come from the stock firmware writing them; they are named by offset or by placeholder.
0x12000000 i8080 size 0x10000 — i8080-style parallel LCD bus controller (DS §5.3, p.264-268). Drives the DM-32's ST7789V-class panel controller (identified 2026-10-11 from the stock init sequence, which uses ST7789V-only commands B2/B7/BB/C0/C2/C3/C6/D0; earlier notes said HX8353E, which rested only on shared MIPI DCS commands): INDEX (+0x0) carries panel commands and DATA (+0x4) pixel/parameter data. FW: 5 direct access sites (init in the LCD driver) plus base literals at 0x0303dad0, 0x0304242c.
0x13000000 USB size 0x40000 — Synopsys DesignWare USB 2.0 OTG controller (GSNPSID reads 0x4f54270a), configured device-only with a USB 1.1 full-speed serial transceiver (GUSBCFG.PHYSel=1) (DS §5.6, p.325-377; Register Table 19 is mistitled 'SDIO Register Overview'). IN endpoints 0/1/3 and OUT endpoints 0/2/4 are implemented. FW: no direct access; one base literal at 0x0301f178. The DM-32's USB-C port is not known to carry data.
0x14000000 TIMER size 0x10000 — DesignWare APB timer (dw_apb_timer), 6 channels of 32-bit down-counters at a 0x14 stride (DS §4.8, p.187-200; Register Table 6 p.188-189). Checked against a live register read of a running DM-32UV (2026-09-27/28). Datasheet errors: Register Table 6 prints Timer5 and Timer6 at 0x3c-0x4c (a copy of Timer4's rows) and §4.8.5.21-30 at 0x0-0x10 (a copy of Timer1's); the stride puts them at 0x50 and 0x64, where the live read shows Timer6 running and where the firmware accesses them (+0x50..+0x70). Datasheet field names are TimerEnable / TimerMode / TimerInterruptMask; this block uses enable / mode / int_mask. TIMERS_COMP_VERSION reads 0x3230322a (DS p.200 and the live read). Channel 0 (TIMER_1) is the uC/OS-III tick: on a live radio LoadCount = 0xcd140, ControlReg = 0x03 (enabled, periodic, unmasked). It is PIC source 1, CPU vector 33 (DS Table 30). Confirmed on hardware 2026-10-01: with source 33 unmasked instead, the timer counted and held its line but nothing was delivered; with source 1 unmasked the ISR fired. Channel 5 (TIMER_6, source 6) drives the 10 Hz UI tick. Not the layout of QEMU's stock csky_timer device, which lacks the per-channel EOI/IntStatus registers (QEMU: dm32uv-qemu hw/timer/dm32_timer.c).
0x14010000 WDG size 0x10000 — Watchdog (DS §4.10, p.212-218). Write 0x5ada7200 to WDG_LOCK to unlock; feed by writing 0x55aadd22 to WDG_KNOCK; a timeout causes a full global reset (v2.2 manual p.32). Default timeout ~60 s, reset pulse ~20 ms. FW: base literal at 0x0305728c (no movih-built accesses). Neither magic value appears as a literal in program flash or the IRAM image, so whether and how stock feeds it is not established. QEMU: the dm32uv-qemu port maps it as plain RAM (it never bites).
0x14020000 GPIOA size 0x10000 — GPIO bank A, Synopsys DesignWare APB GPIO (DS §5.7, p.377-385). Every register is one bit per pin. Pin functions are selected in SystemControl.IO_DIPLEX0-2 first. FW: 158 access sites. Note: decompiler output may show GPIO accesses as uRam00000000: the movih/bseti high-address idiom is not always constant-folded.
0x14030000 UART0 size 0x10000 — UART0, Synopsys DesignWare APB UART, 16550-compatible (DS §5.4, p.268-285). Offsets 0x00/0x04/0x08 are shared: RBR/THR/DLL, IER/DLH (selected by LCR.DLAB) and IIR/FCR (read/write). FW: 28 access sites.
0x14040000 UART1 size 0x10000 — UART1. Same register table as UART0 (DS Register Table 16, p.274). FW: 24 access sites.
0x14050000 UART2 size 0x10000 — UART2. Same register table as UART0 (DS Register Table 17, p.274). FW: no access found.
0x14060000 I2C0 size 0x10000 — I2C0, Synopsys DesignWare APB I2C master/slave (DS §5.1, p.218-243). FW: no direct access or base literal found in program flash. QEMU docs record the ALPU-MP anti-clone handshake (I2C address 0x7a) on this controller; the IRAM code also contains a bit-banged GPIO I2C routine addressing 0x7a. Which path the stock firmware uses is not settled here.
0x14070000 I2C1 size 0x10000 — I2C1. Same register table as I2C0 (DS Register Table 10, p.224-226). FW: no access found.
0x14080000 I2C2 size 0x10000 — I2C2, dedicated to the internal RTC (memory map note, v2.2 manual p.10). Register layout INFERRED identical to I2C0/I2C1 (the v2.7 guide tabulates only I2C0 and I2C1); the offsets the firmware uses all match (FW: 24 sites at 0x0/0x4/0x10/0x30/0x40/0x6c/0x70/0xa0), as does DRV. The RTC is an I2C slave at 7-bit address 0x70 behind this controller, NOT memory-mapped: its 24 byte registers (RTC_VAL_*, RTC_MATCH_*, RTC_LOAD_*, RTC_CCR, RTC_RSTAT, RTC_CLKDIV_*, RTC_SOFT_RST_N at RTC addresses 0x00-0x17) are documented in DS §4.9 (p.200-212) and tabulated in the README accompanying this map, and are reached with IC_DATA_CMD transactions. RTC interrupt: PIC source 19 (vector 51).
0x14090000 UART3 size 0x10000 — UART3. Not tabulated in the v2.7 guide (only UART0-2 are), but DRV gives UART3's offsets explicitly and they match UART0's. FW: no access found.
0x140A0000 SPI_Master0 size 0x10000 — SPI master 0, Synopsys DesignWare APB SSI (DS §5.2, p.243-264; FIFO depth 128). On the DM-32 this is the bus to the 16 MB W25Q128 data flash (chip-select 0x12) holding the codeplug and per-unit calibration (QEMU: dm32uv-qemu dm32_ssi; Winbond W25Q128JV datasheet). FW: first entry of the SSI driver's base table at 0x030ada00 = {SPI_Master0, SPI_Master1, SPI2, SPI_Master3, 0x04000000}, plus 4 direct sites.
0x140B0000 SPI_Master1 size 0x10000 — SPI master 1. Same register table as SPI0 (DS Register Table 12, p.252). FW: second entry of the SSI base table at 0x030ada04; no attached device identified.
0x140C0000 PWM size 0x10000 — PWM, three channels at a 0x20 stride plus a shared interrupt status at 0xff0 (DS §5.8, p.385-400). FW: the base is built arithmetically (at 0x0301c1bc), which a literal/movih sweep cannot see; channel 0 drives the LCD backlight at 1 kHz with seven duty levels.
0x140D0000 ADC size 0x10000 — CPU-side 10-bit ADC controller, 8 channels A-H in pairs per data register (DS §5.9, p.400-423). Distinct from the baseband RX ADC (SystemControl.ADC_CONTROL). FW: 23 sites in 2 code regions, reading all four data registers. The stock per-channel reader table at 0x030ada14 reads channel C as ADC_DATA_CD & 0x3ff (QEMU: dm32_adc.c). Which signal each channel carries on the DM-32 is not established here.
0x140E0000 SPI2 size 0x10000 — SPI2. Same register table as SPI0 (DS Register Table 13, p.254). Some LCD_DB/RD/WR/RS/CS pins can be muxed to it via SystemControl.IO_DIPLEX2. FW: third entry of the SSI base table at 0x030ada08.
0x140F0000 DAC size 0x10000 — CPU-side 12-bit DAC controller, three channels A-C (DS §5.10, p.423-426). Distinct from the baseband TX DAC (SystemControl.DAC_CONTROL). FW: 8 sites, writing PD_CTRL, PD_MODE_EN and all three data registers.
0x14100000 GPIOB size 0x10000 — GPIO bank B (DS Register Table 21). FW: 93 access sites. The keypad row inputs are read here at EXT_PORTA (+0x50).
0x14110000 GPIOC size 0x10000 — GPIO bank C (DS Register Table 22). FW: 99 access sites; drives the keypad columns.
0x14120000 SPI_Slave0 size 0x10000 — SPI slave 0. INFERRED to share the SSI register map: the datasheet has no table for the slave instances, only slave-mode interpretations of CTRLR0 in the SPI table, and the Chinese edition notes the slave FIFO depth is 8 (v2.7 zh p.145: 'spi_slave FIFO深度是8'). FW: no access found.
0x14130000 SPI_Slave1 size 0x10000 — SPI slave 1. INFERRED SSI register map, as SPI_Slave0. FW: no access found.
0x14140000 SPI_Slave2 size 0x10000 — SPI slave 2. INFERRED SSI register map, as SPI_Slave0. FW: no access found.
0x14150000 SPI_Master3 size 0x10000 — SPI master 3, 'EFUSE only' per the memory map (DS p.134). Not tabulated in any datasheet edition, but the stock firmware drives it with exactly the SSI register offsets (FW: 23 sites at 0x0/0x4/0x8/0x10/0x14/0x18/0x1c/0x28/0x2c/0x60, fourth entry of the SSI base table at 0x030ada0c), so the layout is firmware-confirmed. What it is attached to on the DM-32 is not established. No PIC interrupt source.
0x15000000 SDIO size 0x10000 — SD/SDIO host, Synopsys DesignWare Mobile Storage (DS §5.5, p.285-325; FIFO depth 128, data FIFO window from +0x200). FW: no access found; QEMU: reports no card, as on the radio.
0x16000000 Modem_Buffer blocks up to offset 0x960 — Baseband RAM (DS §9.4/§10.4/§11.4, p.520-521, 555-557, 608). Two byte-wide RAMs of 1200 bytes: TX at +0x000 and RX at +0x4b0. Their layout depends on the mode. DMR physical layer: TX SEND_DATA0 +0x00-0x23 and SEND_DATA1 +0x24-0x47 (alternating frames), RX RECV_INFO +0x30-0x53. DMR link layer: PI/LC header, terminator or CSBK at +0x00-0x0b (Table 52). FM: 256-sample 16-bit PCM ping-pong buffers FM_VOICE_1 +0x030-0x22f and FM_VOICE_2 +0x230-0x42f in each RAM, high byte at the lower address. PSPEC also names MODEM_RAM at +0x960 and SOUND at +0x980 (not in the datasheet). The audio codec registers at +0x9c0 are described as the separate CODEC peripheral. FW: 8 byte reads at +0x32/+0x33.
0x160009C0 CODEC size 0x40 — Audio codec control registers, byte-wide (DS §6.5, Register Table 26, p.443-472; base 0x1600_09C0, inside the Modem_Buffer window). Mic inputs, DAC/ADC power and soft mute, digital mixer and AGC/DRC (the latter through indirect windows), gains, sample-rate selection and a countdown timer. Register names match PSPEC. FW: no access found by the movih scan (QEMU: dm32_codec logs named control writes).
0x17000000 PIC size 0x10000 — Programmable interrupt controller, 64 sources of which Table 30 assigns 38 (DS §4.7, p.166-187; Register Table 5 p.170-172). This is the chip's real interrupt controller, not the CK803S built-in VIC at 0xE000E100: the stock firmware makes no 0xE000xxxx accesses (program-flash sweep and live register reads). SOURCE vs VECTOR: source n is bit n of PIC_MODE/PO/MASK/INT_ST/FFLAG_L (n < 32) or bit n-32 of PIC_MODE_1/PO_1/MASK_1/INT_ST_1/FFLAG_H, and byte n%4 of PIC_PRIOR<4*(n/4)>; the CPU sees it as vector n + PIC_VECTOR.vector0 = n + 32 at reset. Table 30 (p.168-169), source/vector: 0 reserved/32, 1 TIMER_1/33, 2 TIMER_2/34, 3 TIMER_3/35, 4 TIMER_4/36, 5 TIMER_5/37, 6 TIMER_6/38, 7 I2C1/39, 8 I2C0/40, 9 I2C2/41, 10 UART1/42, 11 UART2/43, 12 UART0/44, 13 UART3/45, 14 GPIOB/46, 15 GPIOA/47, 16 SPI0/48, 17 GPIOC/49, 18 PWM/50, 19 RTC/51, 20 SDIO/52, 21 USB/53, 22 SPI1/54, 23 SPI2/55, 24 LCSFC/56, 25 DAC/57, 26 ADC/58, 27 PCM_rd_data_interp/59, 28 PCM_wr_data_interp/60, 29 System_inter/61, 30 Time_slot_inter_tx/62, 31 Time_slot_inter_rx/63, 32 Rf_tx_inter/64, 33 Rf_rx_inter/65, 34 SlaveSPI0/66, 35 SlaveSPI1/67, 36 SlaveSPI2/68, 37 Codec_interp/69; all level-triggered, active high. CORRECTED 2026-10-10: the hand-maintained description this replaced listed CPU vectors as 'source assignments' (TIMER_1=33, TIMER_2-4=34-36, UART3=45, GPIOC=49, PCM_rd/wr_data_interp=59/60, System_inter=61, Time_slot_inter_rx=63, Rf_rx_inter=65, Codec_interp=69, and UART1/2/0=42/43/44, ADC=58, Rf_tx=64). Those are vectors; the sources are 1, 2-4, 13, 17, 27/28, 29, 31, 33, 37, 10/11/12, 26, 32. DRV's VECTOR_* defines (C7000_DRV.h: VECTOR_TIMER1-4=33-36, UART3=45, GPIOC=49, PCM_rd/wr_data_interp=59/60, System_inter=61, Time_slot_inter_rx=63, Rf_rx_inter=65, Codec_interp=69; bsp_vic.h: VECTOR_TIMER0=33, VECTOR_USB=53) are vectors too, passed to CKSetIsrVector, which unmasks bit (vector - 32); they agree with Table 30's vector column at every entry. The earlier note that a live trace's 'Time_slot_inter_tx = source 30' and DRV's 'Time_slot_inter_rx = 63' were an unverified TX/RX pair is resolved: Table 30 has tx at source 30/vector 62 and rx at source 31/vector 63. RTOS TICK: TIMER_1 (timer channel 0) is PIC source 1, CPU vector 33. Confirmed on hardware 2026-10-01 (OpenRTX bring-up on a DM-32UV, boot console log): with source 33 unmasked instead, the timer expired and held its line but nothing was delivered; with source 1 unmasked the ISR fired. The stock firmware registers its tick ISR with vector 33, stored at ISR-table index 33 - 32 = 1 (flash 0x0306cf70/0x0306cf38; dm32uv-qemu board-model notes (DM32-BOARD-MODEL.md), session 7). Register names and offsets also come from DRV bsp_vic.h ('Interrupt Controller definitions', Wang Huibin, 2013-05-13; in the DemoUV008 source tree at ucos3/include/bsp/bsp_vic.h), which agrees with Register Table 5 at every offset. Its CKIntcInit (bsp_vic.c) writes MODE = 0, PO = 0xffffffff, MASK = 0xffffffff, MODE_1 = 0, PO_1 = 0xffffffff, then MASK a second time where MASK_1 was probably meant, then INT_ST/INT_ST_1 = 0xffffffff. FW: 24 access sites in 2 code regions, all to MODE/PO/MASK/INT_ST and their upper-bank siblings; no access to PIC_VECTOR, PIC_COW1/2, PIC_PRIOR*, PIC_SYNC or PIC_FFLAG_* was found by the program-flash sweep, which does not cover IRAM (where the interrupt entry path runs).

## Interrupts
7 I2C1 — PIC source 7 (bit 7 of PIC_MASK/INT_ST), default CPU vector 39 (DS Table 30, p.168-169)
8 I2C0 — PIC source 8 (bit 8 of PIC_MASK/INT_ST), default CPU vector 40 (DS Table 30, p.168-169)
9 I2C2 — PIC source 9 (bit 9 of PIC_MASK/INT_ST), default CPU vector 41 (DS Table 30, p.168-169)
10 UART1 — PIC source 10 (bit 10 of PIC_MASK/INT_ST), default CPU vector 42 (DS Table 30, p.168-169)
11 UART2 — PIC source 11 (bit 11 of PIC_MASK/INT_ST), default CPU vector 43 (DS Table 30, p.168-169)
12 UART0 — PIC source 12 (bit 12 of PIC_MASK/INT_ST), default CPU vector 44 (DS Table 30, p.168-169)
13 UART3 — PIC source 13 (bit 13 of PIC_MASK/INT_ST), default CPU vector 45 (DS Table 30, p.168-169)
14 GPIOB — PIC source 14 (bit 14 of PIC_MASK/INT_ST), default CPU vector 46 (DS Table 30, p.168-169)
15 GPIOA — PIC source 15 (bit 15 of PIC_MASK/INT_ST), default CPU vector 47 (DS Table 30, p.168-169)
16 SPI0 (SPI_Master0) — PIC source 16 (bit 16 of PIC_MASK/INT_ST), default CPU vector 48 (DS Table 30, p.168-169)
17 GPIOC — PIC source 17 (bit 17 of PIC_MASK/INT_ST), default CPU vector 49 (DS Table 30, p.168-169)
18 PWM — PIC source 18 (bit 18 of PIC_MASK/INT_ST), default CPU vector 50 (DS Table 30, p.168-169)
20 SDIO — PIC source 20 (bit 20 of PIC_MASK/INT_ST), default CPU vector 52 (DS Table 30, p.168-169)
21 USB — PIC source 21 (bit 21 of PIC_MASK/INT_ST), default CPU vector 53 (DS Table 30, p.168-169)
22 SPI1 (SPI_Master1) — PIC source 22 (bit 22 of PIC_MASK/INT_ST), default CPU vector 54 (DS Table 30, p.168-169)
23 SPI2 — PIC source 23 (bit 23 of PIC_MASK/INT_ST), default CPU vector 55 (DS Table 30, p.168-169)
25 DAC — PIC source 25 (bit 25 of PIC_MASK/INT_ST), default CPU vector 57 (DS Table 30, p.168-169)
26 ADC — PIC source 26 (bit 26 of PIC_MASK/INT_ST), default CPU vector 58 (DS Table 30, p.168-169)
34 SlaveSPI0 (SPI_Slave0) — PIC source 34 (bit 2 of PIC_MASK_1/INT_ST_1), default CPU vector 66 (DS Table 30, p.168-169)
35 SlaveSPI1 (SPI_Slave1) — PIC source 35 (bit 3 of PIC_MASK_1/INT_ST_1), default CPU vector 67 (DS Table 30, p.168-169)
36 SlaveSPI2 (SPI_Slave2) — PIC source 36 (bit 4 of PIC_MASK_1/INT_ST_1), default CPU vector 68 (DS Table 30, p.168-169)
37 Codec_interp (CODEC) — PIC source 37 (bit 5 of PIC_MASK_1/INT_ST_1), default CPU vector 69 (DS Table 30, p.168-169)

## Licence text in the file
License to be decided, as for the rest of the repository this file is published in. The underlying HR_C7000 datasheets (Dahua) are marked "Internal disclosure" and are not included.
