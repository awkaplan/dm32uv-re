/* dm32_patch_memory.ld -- verified-free memory for DM-32UV patches
 *
 * GENERATED by tools/src/dm32_patch_tools/gen_link_artifacts.py -- DO NOT EDIT.
 * Regenerate: python3 tools/src/dm32_patch_tools/gen_link_artifacts.py
 * Staleness check: the same command with --check.
 *
 * Inputs:
 *   data/allocations.json
 *     sha256 efe24201ae586a279a9ce0208a8197215d9fb4ed887daa9eaeeeef745cf2202a
 *     git-commit 74beedfefe97948bbd8e3949be570cba11cb263f
 *   data/firmware/patching/occupied_regions.json
 *     sha256 a11faf7c14f0ca41776a81982bc7d31ee5290d4ebc764b9c2ad2a367c4f0ca70
 *     git-commit cf75c6809ad5c3d947db0a437652496345232607
 *   data/firmware/patching/progmem_stock_DP570UV_20260926_FULL.bin
 *     sha256 9b08ce6d8d0b63617d9c1f9548d93ea6008a9ebce5cd36089752f74a62a09716
 *     git-commit cf75c6809ad5c3d947db0a437652496345232607
 *
 * Free space = the flash/SRAM windows in data/allocations.json minus every allocation
 * listed there (flash rounded to whole 4 KiB sectors). The flash window was re-checked to
 * be all-0xFF in the full stock image and disjoint from the per-unit sector 0x0300b000
 * and from every data/firmware/patching/occupied_regions.json entry when this was generated.
 *
 * USE: INCLUDE this file at the top level of your linker script and place sections with
 * `> PATCH_FLASH` / `> PATCH_SRAM` (or a specific PATCH_<SPACE>_<n>). Overflowing a region
 * fails the link. Every address that is NOT free is covered by a NOLOAD section named
 * .dm32_reserved.<what>; a section given an explicit address that overlaps one fails the
 * link with 'section ... overlaps section .dm32_reserved.<what>'.
 * The reservations are NOBITS: they add nothing to `objcopy -O binary` output, but they do
 * appear as zero-file-size PT_LOAD segments in the patch ELF. Extract the patch with
 * objcopy (as every build script here does); never load the patch ELF itself onto a target.
 *
 * To claim space for a new patch: add it to data/allocations.json and regenerate.
 */

MEMORY
{
    PATCH_FLASH_0    (rx) : ORIGIN = 0x030e2000, LENGTH = 0x6000    /* 0x030e2000-0x030e7fff, 24 KiB, sectors 226-231 */
    PATCH_FLASH_1    (rx) : ORIGIN = 0x030ea000, LENGTH = 0x16000    /* 0x030ea000-0x030fffff, 88 KiB, sectors 234-255 */
    PATCH_SRAM_0     (rw!x) : ORIGIN = 0x18004c00, LENGTH = 0x2400    /* 0x18004c00-0x18006fff, 9 KiB */
    PATCH_SRAM_1     (rw!x) : ORIGIN = 0x18007310, LENGTH = 0xcd0    /* 0x18007310-0x18007fdf, 3 KiB */
}

REGION_ALIAS("PATCH_FLASH", PATCH_FLASH_1);   /* largest free flash region */
REGION_ALIAS("PATCH_SRAM", PATCH_SRAM_0);   /* largest free sram region */

/* Existing claims, as symbols (for build scripts / sanity checks). */
PROVIDE(__dm32_alloc_ramdump_probe_code_start = 0x030e1000);
PROVIDE(__dm32_alloc_ramdump_probe_code_end = 0x030e2000);
PROVIDE(__dm32_alloc_snake_code_start = 0x030e8000);
PROVIDE(__dm32_alloc_snake_code_end = 0x030ea000);
PROVIDE(__dm32_alloc_snake_state_start = 0x18007000);
PROVIDE(__dm32_alloc_snake_state_end = 0x18007310);
PROVIDE(__dm32_alloc_overlay_guard_start = 0x18007fe0);
PROVIDE(__dm32_alloc_overlay_guard_end = 0x18007ff0);
PROVIDE(__dm32_alloc_ramdump_cursor_start = 0x18007ff0);
PROVIDE(__dm32_alloc_ramdump_cursor_end = 0x18008000);

/* Everything that is not free. NOLOAD: never emitted, only collision-checked. */
SECTIONS
{
    /* IRAM: uC/OS-III, drivers, stacks, runtime state; no verified-free space (docs/rtos-and-memory.md) */
    .dm32_reserved.stock_iram 0x00010000 (NOLOAD) : { . = . + 0x40400; }
    /* stock firmware (vendor update file 0x03000000-0x030d20ff) and, inside it: per_unit_sector, alpu_bypass_sector, occupied_regions.json[0x0300b000-0x0300c000), occupied_regions.json[0x030bfc20-0x030decb8), occupied_regions.json[0x030decb8-0x030e04c0), occupied_regions.json[0x03072000-0x030763fc) */
    .dm32_reserved.stock_flash 0x03000000 (NOLOAD) : { . = . + 0xe1000; }
    /* allocated: live-RAM-capture probe family (RAMDUMP / megaprobe / audioprobe / pllprobe handlers), whole-sector handler, sector 225 [tools/src/dm32_patch_tools/export_patch_sites.py id 'megaprobe-handler' (addr 0x030E1000, hardware-verified); docs/rtos-and-memory.md 'Known allocations'; docs/live-ram-capture.md; tools/examples/build_overlay_image.py HANDLER] */
    .dm32_reserved.ramdump_probe_code 0x030e1000 (NOLOAD) : { . = . + 0x1000; }
    /* allocated: Snake example patch: game handler, category entry, trampolines, strings and relocated jump/label tables (sectors 232-233) [tools/examples/snake/build_snake_patch.py SNAKE_*_ADDR constants (0x030e8000..0x030e91b0); tools/examples/snake/snake_game.ld; docs/rtos-and-memory.md 'Known allocations'] */
    .dm32_reserved.snake_code 0x030e8000 (NOLOAD) : { . = . + 0x2000; }
    /* XIP window beyond the 1 MB GD25Q80: no flash behind these addresses */
    .dm32_reserved.flash_not_present 0x03100000 (NOLOAD) : { . = . + 0xf00000; }
    /* SRAM: modem-owned 0x18000000-0x180007ff + initialised-data image 0x18000800-0x18004bfc (occupied_regions.json) */
    .dm32_reserved.stock_sram 0x18000000 (NOLOAD) : { . = . + 0x4c00; }
    /* allocated: Snake example patch .bss (game state, 0x310 bytes) [tools/examples/snake/snake_game.ld (.bss 0x18007000); tools/include/dm32_patch_api.h; docs/rtos-and-memory.md 'Already allocated inside that window'] */
    .dm32_reserved.snake_state 0x18007000 (NOLOAD) : { . = . + 0x310; }
    /* allocated: overlay_trampoline.S re-entrancy GUARD word (4 bytes used; the 16-byte slot up to the RAMDUMP cursor is reserved with it) [tools/examples/overlay_trampoline.S (.equ GUARD, 0x18007FE0); tools/include/dm32_patch_api.h] */
    .dm32_reserved.overlay_guard 0x18007fe0 (NOLOAD) : { . = . + 0x10; }
    /* allocated: RAMDUMP live-RAM-read patch dump cursor (16 bytes, top of SRAM) [tools/include/dm32_patch_api.h; docs/rtos-and-memory.md; tools/src/dm32_patch_tools/dm32_ramdump.py (sub-ids 0x3f/0x40)] */
    .dm32_reserved.ramdump_cursor 0x18007ff0 (NOLOAD) : { . = . + 0x10; }
}
